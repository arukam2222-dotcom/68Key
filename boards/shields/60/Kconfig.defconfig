## boards/shields/60/Kconfig.defconfig
```kconfig
if SHIELD_60_RIGHT

config ZMK_KEYBOARD_NAME
    default "60"

endif

if SHIELD_60_LEFT || SHIELD_60_RIGHT

config ZMK_SPLIT
    default y

endif
```

## boards/shields/60/Kconfig.shield
```kconfig
config SHIELD_60_LEFT
    def_bool $(shields_list_contains,60_left)
config SHIELD_60_RIGHT
    def_bool $(shields_list_contains,60_right)
```
